# S32R372 register map
Vendor: Freescale Semiconductor, Inc.; Series: Qorivva; File version: 1.6
S32R372 Freescale Microcontroller
Registers are 32-bit, read-write, reset 0x0 unless marked. A register's access mark holds for its fields unless they carry their own. Offsets are from the block's base; lines under a group give offsets from that group; [hi:lo] are bit positions; {n}, {i} and the like mark numbered series; 'fields as' and 'values as' point back to an identical list; <NAME> marks a mode.

## Memory map
0xF8000000 AIPS_1 size 0x1C0 — AIPS-Lite Bridge
0xFBC00000 FlexPWM_0 size 0x154 — FlexPWM
0xFBC10000 CTU size 0xD8
0xFBE00000 ADC_0 size 0x3AC — 12-bit SAR ADC
0xFBE68000 I2C_1 size 0x7 — I2C
0xFBE6C000 I2C_2 size 0x7 — I2C
0xFBE70000 SPI_2 size 0x90 — Serial Peripheral Interface
0xFBEC0000 CAN_2 size 0xC0C — Flex Controller Area Network module
0xFBF08000 MIPICSI2 size 0x68 — Camera Serial Interface
0xFBF0C000 AFE size 0x80
0xFBF58000 FCCU size 0x12C
0xFBF64000 CRC_1 size 0x30 — CRC
0xFBF6C000 DMAMUX_1 size 0x10 — DMA channel multiplexor
0xFBFB0200 CMU_0 size 0x1C — CMU
0xFBFB0280 CMU_2 size 0x1C — CMU
0xFBFB02C0 CMU_3 size 0x1C — CMU
0xFBFB0300 CMU_4 size 0x1C — CMU
0xFBFB0380 CMU_6 size 0x1C — CMU
0xFBFB03C0 CMU_7 size 0x1C — CMU
0xFBFB0400 CMU_8 size 0x1C — CMU
0xFBFB0440 CMU_9 size 0x1C — CMU
0xFBFB0480 CMU_10 size 0x1C — CMU
0xFBFB04C0 CMU_11 size 0x1C — CMU
0xFBFB0500 CMU_12 size 0x1C — CMU
0xFC000000 AIPS_0 size 0x1C0 — AIPS-Lite Bridge
0xFC004000 AXBS_0 size 0x714 — Crossbar switch
0xFC008000 AXBS_1 size 0x714 — Crossbar switch
0xFC00C000 PRAM_XBAR size 0x714
0xFC010000 SMPU_0 size 0x500 — Memory protection unit
0xFC014000 SMPU_1 size 0x500 — Memory protection unit
0xFC018000 XBIC_0 size 0x10 — XBIC
0xFC01C000 XBIC_1 size 0x10 — XBIC
0xFC020000 PRAMC size 0x18 — RAM controller
0xFC024000 XBIC_2 size 0x10 — XBIC
0xFC028000 PCM blocks up to offset 0x18 — Platform Configuration Module
0xFC030000 PFLASH size 0x17C — PFLASH_C55FM
0xFC03C000 SEMA42 size 0x42
0xFC040000 INTC size 0x1098
0xFC044000 XBIC_4 size 0x10 — XBIC
0xFC054000 SWT_1 size 0x1C — SWT
0xFC058000 SWT_2 size 0x1C — SWT
0xFC06C000 STM_1 size 0x4C — STM
0xFC070000 STM_2 size 0x4C — STM
0xFC074000 CSE size 0x38
0xFC078000 TDM size 0x20
0xFC07C000 EIM size 0x10C — Error Injection Module
0xFC0A0000 DMA size 0x1400 — Enhanced direct memory access controller
0xFFC0C000 MCB blocks up to offset 0x402C — Multipurpose registers
0xFFC24000 ETIMER_1 size 0x114 — eTimer
0xFFD0C000 CTE size 0x288 — CTE Memory Map
0xFFD10000 SPT size 0x3D0 — Signal Processing Toolbox
0xFFE04000 ADC_1 size 0x3AC — 12-bit SAR ADC
0xFFE74000 SPI_1 size 0x90 — Serial Peripheral Interface
0xFFE90000 LINFlexD_1 size 0xA0 — LINFlexD
0xFFEC0000 CAN_0 size 0xC0C — Flex Controller Area Network module
0xFFF38000 DTS size 0x10
0xFFF44000 STCU2 size 0x704
0xFFF48000 JTAGM size 0x24
0xFFF50000 MEMU size 0xCCC
0xFFF64000 CRC_0 size 0x30 — CRC
0xFFF6C000 DMAMUX_0 size 0x10 — DMA channel multiplexor
0xFFF80000 PIT_1 size 0x140 — Periodic Interrupt Timer
0xFFF84000 PIT_0 size 0x140 — Periodic Interrupt Timer
0xFFF98000 WKPU size 0xC
0xFFFA0000 MC_PCU blocks up to offset 0x44 — PCU
0xFFFA0400 PMC blocks up to offset 0xB8
0xFFFA8000 RGM size 0x609 — Unless otherwise noted, all registers may be accessed as 32-bit words, 16-bit half-words, or 8-bit bytes.
0xFFFB0000 MC_CGM blocks up to offset 0x9CC — Unless otherwise noted, all registers may be accessed as 32-bit words, 16-bit half-words, or 8-bit bytes.
0xFFFB0000 IRCOSC size 0x4
0xFFFB0100 PLLDIG size 0x34
0xFFFB8000 MC_ME size 0x1F0
0xFFFC0000 SIUL2 blocks up to offset 0x17B4
0xFFFE0000 C55FMC size 0x94
0xFFFF4000 PASS size 0x140
0xFFFF8000 SSCM size 0x38

## Licence text in the file
Redistribution and use in source and binary forms, with or without modification, are permitted provided that the following conditions are met: o Redistributions of source code must retain the above copyright notice, this list of conditions and the following disclaimer. o Redistributions in binary form must reproduce the above copyright notice, this list of conditions and the following disclaimer in the documentation and/or other materials provided with the distribution. o Neither the name of Freescale Semiconductor, Inc. nor the names of its contributors may be used to endorse or promote products derived from this software without specific prior written permission. THIS SOFTWARE IS PROVIDED BY THE COPYRIGHT HOLDERS AND CONTRIBUTORS "AS IS" AND. ANY EXPRESS OR IMPLIED WARRANTIES, INCLUDING, BUT NOT LIMITED TO, THE IMPLIED. WARRANTIES OF MERCHANTABILITY AND FITNESS FOR A PARTICULAR PURPOSE ARE. DISCLAIMED. IN NO EVENT SHALL THE COPYRIGHT HOLDER OR CONTRIBUTORS BE LIABLE FOR. ANY DIRECT, INDIRECT, INCIDENTAL, SPECIAL, EXEMPLARY, OR CONSEQUENTIAL DAMAGES (INCLUDING, BUT NOT LIMITED TO, PROCUREMENT OF SUBSTITUTE GOODS OR SERVICES; LOSS OF USE, DATA, OR PROFITS; OR BUSINESS INTERRUPTION) HOWEVER CAUSED AND ON. ANY THEORY OF LIABILITY, WHETHER IN CONTRACT, STRICT LIABILITY, OR TORT (INCLUDING NEGLIGENCE OR OTHERWISE) ARISING IN ANY WAY OUT OF THE USE OF THIS. SOFTWARE, EVEN IF ADVISED OF THE POSSIBILITY OF SUCH DAMAGE.
